## meta-eos/conf/layer.conf
```bitbake
BBPATH .= ":${LAYERDIR}"
BBFILES += "${LAYERDIR}/recipes*/*/*.bb ${LAYERDIR}/recipes*/*/*.bbappend"
BBFILE_COLLECTIONS += "eos-hybris-layer"
BBFILE_PATTERN_eos-hybris-layer := "^${LAYERDIR}/"
BBFILE_PRIORITY_eos-hybris-layer = "8"
LAYERSERIES_COMPAT_eos-hybris-layer = "walnascar"
```
